## block/Kconfig.iosched.rej
```kconfig
--- block/Kconfig.iosched
+++ block/Kconfig.iosched
@@ -167,6 +171,9 @@ choice
    config DEFAULT_SIOPLUS
 	bool "SIOPLUS" if IOSCHED_SIOPLUS=y
 
+	config DEFAULT_MAPLE
+		bool "Maple" if IOSCHED_MAPLE=y
+
    config DEFAULT_NOOP
 	bool "No-op"
 
@@ -190,6 +197,7 @@ config DEFAULT_IOSCHED
    default "noop" if DEFAULT_NOOP
    default "zen" if DEFAULT_ZEN
    default "vr" if DEFAULT_VR
+	default "maple" if DEFAULT_MAPLE
 
 endmenu
 
```
